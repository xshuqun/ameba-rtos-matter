## project/cmake/Kconfig
```kconfig
menu "Matter Config"
    config MATTER_EN
        bool "Enable Matter"
        default n
    if MATTER_EN
        choice
            prompt "Ameba RTOS version"
            default AMEBARTOS_V1_2
            config AMEBARTOS_V1_1
                bool "Ameba RTOS v1.1"
            config AMEBARTOS_V1_2
                bool "Ameba RTOS v1.2"
        endchoice
        config MBEDTLS_V_3_6_2_ENABLE
            bool
            default y
            depends on (AMEBADPLUS || AMEBALITE || AMEBASMART)
        config MBEDTLS_V_3_6_5_ENABLE
            bool
            default y
            depends on (AMEBAGREEN2)
        config BLE_MATTER_ADAPTER
            bool "BLE Matter Adapter"
            default n
            depends on BT_MENU
            if BLE_MATTER_ADAPTER
                config BLE_MATTER_MULTI_ADV_ON
                    bool "Enable BLE Matter Multi Adv"
                    default n
            endif
        config MATTER_ENABLE_IPV4
            bool "Enable Matter IPv4"
            default n
        config MATTER_ENABLE_TCP_ENDPOINT
            bool "Enable Matter TCP Endpoint"
            default n
        config MATTER_TC_EN
            bool "Enable Matter Terms and Condition"
            default n
        config MATTER_ICD_EN
            bool "Enable Matter ICD"
            default n
            if MATTER_ICD_EN
                config MATTER_ICD_LIT_EN
                    bool "Enable Matter ICD LIT"
                    default n
            endif
        config MATTER_TIME_SYNC_EN
            bool "Enable Matter Time Sync"
            default n

        config MATTER_DEVICE_VENDOR_ID
            hex "Matter device vendor ID"
            default 0xFFF1
            help
              Vendor ID reported in the Basic Information cluster and written into
              the Matter OTA image header. Use your CSA-allocated vendor ID for
              products; 0xFFF1 is the test vendor ID.

        config MATTER_DEVICE_PRODUCT_ID
            hex "Matter device product ID"
            default 0x8001
            help
              Product ID reported in the Basic Information cluster and written
              into the Matter OTA image header. 0x8001 is the test product ID.

        config MATTER_DEVICE_SOFTWARE_VERSION
            int "Matter device software version"
            default 2
            help
              Numeric software version compiled into the firmware and written
              into the Matter OTA image header. Keep the two in step: after the
              update reboots, the new firmware confirms the image by comparing
              its own version against the one the OTA image declared, so an
              image built with a different version is not reported as applied.
              Bump this before building an image to distribute over OTA.

        config MATTER_DEVICE_SOFTWARE_VERSION_STR
            string "Matter device software version string"
            default "2.0"
            help
              Human-readable software version, reported alongside the numeric
              version. "2.0" is the test version string.

        config MATTER_SECURE_EN
            bool "Enable Matter Secure"
            default n
            depends on ((AMEBADPLUS || AMEBALITE || AMEBAGREEN2) && (TRUSTZONE_FOR_KM4 || TRUSTZONE_EN)) || (AMEBASMART)
        config MATTER_SECURE
            bool
            default y
            depends on MATTER_SECURE_EN
        config COMPILE_MBEDTLS_FROM_MATTER_SECURE
            bool "Compile MbedTLS from Matter Secure (NOT NEEDED FOR LATEST V1.1 AND V1.2)"
            default n
            depends on MATTER_SECURE_EN
        config TZ_S_SIZE
            int
            default 136 if AMEBADPLUS
            default 120 if AMEBALITE
            depends on (AMEBARTOS_V1_1 && MATTER_SECURE_EN)
        config SECURE_HEAP_SIZE
            int
            default 14336
            depends on MATTER_SECURE_EN
    endif
endmenu
```
